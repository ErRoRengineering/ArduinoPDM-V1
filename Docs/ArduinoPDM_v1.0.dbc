VERSION ""

NS_ :

BS_:

BU_: PDM

BO_ 100 PDM_Status: 8 PDM
 SG_ RelayStatus : 0|8@1+ (1,0) [0|255] "" PDM

BO_ 101 PDM_Command: 8 PDM
 SG_ ToggleMask  : 0|8@1+ (1,0) [0|255] "" PDM
 SG_ DirectMask  : 8|8@1+ (1,0) [0|255] "" PDM

BO_ 102 PDM_ConfigSet: 8 PDM
 SG_ ConfigID    : 0|8@1+ (1,0) [0|255] "" PDM
 SG_ ConfigValue : 8|32@1+ (1,0) [0|4294967295] "" PDM

BO_ 103 PDM_ConfigSave: 1 PDM
 SG_ Save        : 0|1@1+ (1,0) [0|1] "" PDM

CM_ BO_ 100 "Statusmeddelande från PDM med nuvarande relästatus som bitmask.";
CM_ BO_ 101 "Kommandomeddelande till PDM för att toggla eller direktstyra reläer.";
CM_ BO_ 102 "Konfigurationsmeddelande för att ställa in olika parametrar (ex. CAN-frekvens, mode).";
CM_ BO_ 103 "Meddelande för att spara konfiguration till EEPROM.";
